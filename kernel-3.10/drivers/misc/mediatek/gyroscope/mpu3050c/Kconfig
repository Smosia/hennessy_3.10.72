## kernel-3.10/drivers/misc/mediatek/gyroscope/mpu6050c/Kconfig
```kconfig
config MTK_MPU6050C
        bool "MPU6050C for MediaTek package"
        default n
```

## kernel-3.10/drivers/misc/mediatek/gyroscope/mpu6515/Kconfig
```kconfig
config MTK_MPU6515G
        bool "MPU6515G for MediaTek package"
        default n
```

## kernel-3.10/drivers/misc/mediatek/hall_sensor/Kconfig
```kconfig
config CUSTOM_KERNEL_HALL
	bool "CUSTOM_KERNEL_HALL"
	help
	  hall sensor driver

source "drivers/misc/mediatek/hall_sensor/ah1903/Kconfig"
```

## kernel-3.10/drivers/misc/mediatek/hall_sensor/ah1903/Kconfig
```kconfig
config MTK_AH1903
	bool "AH1903 hall sensor driver for MediaTek package"
	default y
	help
	  To claim the support of hall sensor AH1903.
	  If this option is set,
	  it will support hall sensor function of AH1903.
	  If unsure,say N.
```

## kernel-3.10/drivers/misc/mediatek/irtx/Kconfig
```kconfig
config MTK_IRTX_SUPPORT
	bool "MediaTek consumer IR transmitter"
	default y
	---help---
	  IRTX driver support for MediaTek SoC
```

## kernel-3.10/drivers/misc/mediatek/magnetometer/Kconfig
```kconfig
config MTK_AUTO_DETECT_MAGNETOMETER
	bool "MTK_AUTO_DETECT_MAGNETOMETER"
	help
	  one load to support different magnetometer sensor.
          This feature Option is used for projects which using more than one
	  magnetometer, more than one ALSPS drivers can be builded in to
	  project and be auto detected by setting this option to yes

config CUSTOM_KERNEL_MAGNETOMETER
	bool "CUSTOM_KERNEL_MAGNETOMETER"
	help
	  compass driver to detect compass raw data and report orientatino
	  data. A compass is an instrument used for navigation and
          orientation that shows direction relative to the geographic
          cardinal directions, or "points".

source "drivers/misc/mediatek/magnetometer/af7133/Kconfig"
source "drivers/misc/mediatek/magnetometer/akm8963/Kconfig"
source "drivers/misc/mediatek/magnetometer/akm8963-new/Kconfig"
source "drivers/misc/mediatek/magnetometer/akm8975/Kconfig"
source "drivers/misc/mediatek/magnetometer/akm8975_auto/Kconfig"
source "drivers/misc/mediatek/magnetometer/akm09911/Kconfig"
source "drivers/misc/mediatek/magnetometer/akm09911-new/Kconfig"
source "drivers/misc/mediatek/magnetometer/ami304/Kconfig"
source "drivers/misc/mediatek/magnetometer/ami304_auto/Kconfig"
source "drivers/misc/mediatek/magnetometer/bmm050/Kconfig"
source "drivers/misc/mediatek/magnetometer/bmm050-new/Kconfig"
source "drivers/misc/mediatek/magnetometer/bmm056/Kconfig"
source "drivers/misc/mediatek/magnetometer/bmm056-new/Kconfig"
source "drivers/misc/mediatek/magnetometer/bmm150/Kconfig"
source "drivers/misc/mediatek/magnetometer/hscdtd006/Kconfig"
source "drivers/misc/mediatek/magnetometer/hscdtd006_auto/Kconfig"
source "drivers/misc/mediatek/magnetometer/ist8303-new/Kconfig"
source "drivers/misc/mediatek/magnetometer/lsm303c-new/Kconfig"
source "drivers/misc/mediatek/magnetometer/lsm303m/Kconfig"
source "drivers/misc/mediatek/magnetometer/mag3110/Kconfig"
source "drivers/misc/mediatek/magnetometer/mc41xx/Kconfig"
source "drivers/misc/mediatek/magnetometer/mc64xx/Kconfig"
source "drivers/misc/mediatek/magnetometer/mc6420/Kconfig"
source "drivers/misc/mediatek/magnetometer/mmc328x/Kconfig"
source "drivers/misc/mediatek/magnetometer/mmc328x_auto/Kconfig"
source "drivers/misc/mediatek/magnetometer/mmc328xma/Kconfig"
source "drivers/misc/mediatek/magnetometer/mmc3416x/Kconfig"
source "drivers/misc/mediatek/magnetometer/qmc5983/Kconfig"
source "drivers/misc/mediatek/magnetometer/s62x/Kconfig"
source "drivers/misc/mediatek/magnetometer/yamaha529/Kconfig"
source "drivers/misc/mediatek/magnetometer/yamaha530/Kconfig"
source "drivers/misc/mediatek/magnetometer/yamaha532/Kconfig"
source "drivers/misc/mediatek/magnetometer/yamaha532-new/Kconfig"
source "drivers/misc/mediatek/magnetometer/yamaha537/Kconfig"
```
