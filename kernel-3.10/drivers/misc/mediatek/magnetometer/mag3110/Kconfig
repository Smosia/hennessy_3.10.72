## kernel-3.10/drivers/misc/mediatek/magnetometer/yamaha532-new/Kconfig
```kconfig
config MTK_YAS532_NEW
        bool "YAS532 for Mediatek package"
        default n
```

## kernel-3.10/drivers/misc/mediatek/ssw/Kconfig
```kconfig
config CUSTOM_KERNEL_SSW
	string "CUSTOM_KERNEL_SSW"
	help
	  To choose kernel sim switch driver
```
