## kernel-3.10/drivers/misc/mediatek/fingerprint/FPC_1022/Kconfig
```kconfig
config FINGERPRINT_FPC1022
	tristate "Fingerprint FPC1022"
	default y
	---help---
	Fingerprint mtk driver enable/disable in the kernel.
	Say Y here if you want to use mediatek fingerprint driver,
	fingerprint driver will support fingerprint function in REE,
	it supports FPC's 102x/104x device.
```

## kernel-3.10/drivers/misc/mediatek/fingerprint/Kconfig
```kconfig
#
#Fingerprint
#

config MTK_FINGERPRINT
	bool "CONFIG_MTK_FINGERPRINT"
	default n

source "drivers/misc/mediatek/fingerprint/FPC_1022/Kconfig"
source "drivers/misc/mediatek/fingerprint/fpc_irq/Kconfig"
source "drivers/misc/mediatek/fingerprint/gf516m/Kconfig"
```

## kernel-3.10/drivers/misc/mediatek/fingerprint/fpc_irq/Kconfig
```kconfig
config FINGERPRINT_FPC_IRQ
     default y
     tristate "FPC_IRQ family fingerprint sensor support"	
     depends on SPI_MASTER
```

## kernel-3.10/drivers/misc/mediatek/fingerprint/gf516m/Kconfig
```kconfig
config FINGERPRINT_GF516
	tristate "Fingerprint GF516"
	default y
	---help---
	Fingerprint mtk driver enable/disable in the kernel.
	Say Y here if you want to use mediatek fingerprint driver,
	fingerprint driver will support fingerprint function in REE,
	it supports GF516 device.
```

## kernel-3.10/drivers/misc/mediatek/gyroscope/ITG1010-new/Kconfig
```kconfig
config MTK_ITG1010_NEW
        bool "ITG1010 for MediaTek package"
        default n
```

## kernel-3.10/drivers/misc/mediatek/gyroscope/Kconfig
```kconfig
config CUSTOM_KERNEL_GYROSCOPE
	bool "CUSTOM_KERNEL_GYROSCOPE"
	help
	  gyroscope driver

source "drivers/misc/mediatek/gyroscope/lsm6ds3_gyro/Kconfig"
source "drivers/misc/mediatek/gyroscope/bmi160_gyro/Kconfig"
```

## kernel-3.10/drivers/misc/mediatek/gyroscope/bmi160_gyro/Kconfig
```kconfig
config MTK_BMI160_GYRO
        bool "BMI160 for MediaTek package"
        default y
        help
        It support different gyroscope sensor.
        If this option is set,
	  	it will support
         BMI160 gyroscope.
```

## kernel-3.10/drivers/misc/mediatek/gyroscope/lsm6ds3_gyro/Kconfig
```kconfig
config MTK_LSM6DS3_GYRO
	bool "ST LSM6DS3 Gyroscope driver for MediaTek package"
	default y
	help
	  To claim the support of gyroscope of LSM6DS3 A+G sensor.
	  If this option is set,
	  it will support gyroscope function of LSM6DS3.
	  If unsure,say N.
```

## kernel-3.10/drivers/misc/mediatek/gyroscope/mpu3050c-new/Kconfig
```kconfig
config MTK_MPU3050C_NEW
        bool "MPU3050C for MediaTek package"
        default n
```
