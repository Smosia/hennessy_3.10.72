## kernel-3.10/drivers/misc/mediatek/accelerometer/KXTJ2_1009-new/Kconfig
```kconfig
config MTK_KXTJ2_1009_NEW
        bool "KXTJ2_1009 for MediaTek package"
        default n
```

## kernel-3.10/drivers/misc/mediatek/accelerometer/bma056/Kconfig
```kconfig
config MTK_BMA056
        bool "MTK_BMA056 for MediaTek package"
        default n
```

## kernel-3.10/drivers/misc/mediatek/accelerometer/bma250e/Kconfig
```kconfig
config MTK_BMA250E
        bool "MTK_BMA250E for MediaTek package"
        default n
```

## kernel-3.10/drivers/misc/mediatek/accelerometer/bmi160_acc/Kconfig
```kconfig
config MTK_BMI160_ACC

	bool "BMI160_ACC for MediaTek package"
	default n
	help
	  It support different accelerometer sensor.
          If this option is set,
	  it will support
          BMI160_ACC Accelerometer.
```

## kernel-3.10/drivers/misc/mediatek/accelerometer/lsm6ds3/Kconfig
```kconfig
config MTK_LSM6DS3
        bool "MTK_LSM6DS3 for MediaTek package"
        default y
	help
	  It support different accelerometer sensor.
          If this option is set,
	  it will support
          MTK_LSM6DS3 Accelerometer.
```

## kernel-3.10/drivers/misc/mediatek/accelerometer/mc3xxx_auto/Kconfig
```kconfig
config MTK_MC3XXX_AUTO
        bool "MTK_MC3XXX_AUTO for MediaTek package"
        default n
```

## kernel-3.10/drivers/misc/mediatek/accelerometer/mpu60x0/Kconfig
```kconfig
config MTK_MPU60X0
        bool "MPU60X0 for MediaTek package"
        default n
```

## kernel-3.10/drivers/misc/mediatek/accelerometer/mpu6515/Kconfig
```kconfig
config MTK_MPU6515A
        bool "MPU6515A for MediaTek package"
        default n
```
